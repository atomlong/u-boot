## configs/StrawberryPi_Zero_flash_defconfig
```kconfig
CONFIG_ARM=y
CONFIG_ARCH_SUNXI=y
CONFIG_ENV_SIZE=0x10000
CONFIG_ENV_OFFSET=0x88000
CONFIG_ENV_SECT_SIZE=0x1000
CONFIG_MACH_SUN8I_V3S=y
CONFIG_DRAM_CLK=360
CONFIG_DEFAULT_DEVICE_TREE="sun8i-v3s-strawberrypi-zero"
CONFIG_CONS_INDEX=3
CONFIG_CMD_SF=y
CONFIG_CMD_SPI=y
CONFIG_CMD_MTD=y
CONFIG_CMD_MTDPARTS=y
CONFIG_MTD=y
CONFIG_DM_MTD=y
CONFIG_DM_SPI=y
CONFIG_DM_SPI_FLASH=y
CONFIG_SPI=y
CONFIG_SPI_FLASH=y
CONFIG_SPI_FLASH_WINBOND=y
CONFIG_SPI_FLASH_MTD=y
# CONFIG_SPI_FLASH_USE_4K_SECTORS is not set
CONFIG_SPL=y
CONFIG_SPL_SPI_SUNXI=y
# CONFIG_ENV_IS_IN_FAT is not set
CONFIG_MTDIDS_DEFAULT="nor0=spi0.0"
CONFIG_MTDPARTS_DEFAULT="spi0.0:1M(uboot),64k(dtb),3M(kernel),-(rootfs)"
CONFIG_ENV_IS_IN_SPI_FLASH=y
CONFIG_USE_BOOTARGS=y
CONFIG_BOOTARGS="console=ttyS2,115200 earlyprintk panic=5 rootwait root=mtd3 rw rootfstype=jffs2"
CONFIG_USE_BOOTCOMMAND=y
CONFIG_BOOTCOMMAND="sf probe 0; sf read 0x41800000 0x100000 0x10000; sf read 0x41000000 0x110000 0x300000; bootz 0x41000000 - 0x41800000"
```
